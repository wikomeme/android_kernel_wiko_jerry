## arch/arm/configs/v2800_defconfig
```kconfig
# CONFIG_ARM_PATCH_PHYS_VIRT is not set
CONFIG_PHYS_OFFSET=0x80000000
CONFIG_CROSS_COMPILE="arm-eabi-"
# CONFIG_LOCALVERSION_AUTO is not set
CONFIG_AUDIT=y
CONFIG_NO_HZ=y
CONFIG_HIGH_RES_TIMERS=y
CONFIG_CGROUPS=y
CONFIG_CGROUP_CPUACCT=y
CONFIG_CGROUP_SCHED=y
CONFIG_RT_GROUP_SCHED=y
CONFIG_BLK_DEV_INITRD=y
CONFIG_EMBEDDED=y
CONFIG_MTK_AAL_SUPPORT=y
# CONFIG_SLUB_DEBUG is not set
CONFIG_PROFILING=y
# CONFIG_BLK_DEV_BSG is not set
CONFIG_ARCH_MT6580=y
CONFIG_SMP=y
CONFIG_HAVE_ARM_ARCH_TIMER=y
CONFIG_NR_CPUS=8
CONFIG_PREEMPT=y
CONFIG_AEABI=y
CONFIG_HIGHMEM=y
# CONFIG_BOUNCE is not set
CONFIG_ZSMALLOC=y
CONFIG_ZNDSWAP=y
CONFIG_SECCOMP=y
CONFIG_USE_OF=y
CONFIG_BUILD_ARM_APPENDED_DTB_IMAGE=y
CONFIG_BUILD_ARM_APPENDED_DTB_IMAGE_NAMES="v2800"
CONFIG_CMDLINE="console=tty0 console=ttyMT3,921600n1 root=/dev/ram vmalloc=496M slub_max_order=0 slub_debug=O androidboot.selinux=permissive"
CONFIG_AUTO_ZRELADDR=y
CONFIG_CPU_FREQ=y
CONFIG_CPU_FREQ_STAT_DETAILS=y
CONFIG_CPU_FREQ_DEFAULT_GOV_INTERACTIVE=y
CONFIG_CPU_FREQ_GOV_PERFORMANCE=y
CONFIG_CPU_FREQ_GOV_POWERSAVE=y
CONFIG_CPU_FREQ_GOV_USERSPACE=y
CONFIG_CPU_FREQ_GOV_ONDEMAND=y
CONFIG_VFP=y
CONFIG_NEON=y
# CONFIG_CORE_DUMP_DEFAULT_ELF_HEADERS is not set
CONFIG_HIBERNATION=y
CONFIG_PM_AUTOSLEEP=y
CONFIG_PM_WAKELOCKS=y
CONFIG_NET=y
CONFIG_PACKET=n
CONFIG_UNIX=y
CONFIG_XFRM_USER=y
CONFIG_XFRM_SUB_POLICY=y
CONFIG_XFRM_MIGRATE=y
CONFIG_NET_KEY=n
CONFIG_INET=y
CONFIG_IP_MULTICAST=n
CONFIG_IP_ADVANCED_ROUTER=n
CONFIG_IP_MULTIPLE_TABLES=n
CONFIG_IP_PNP=n
CONFIG_IP_PNP_DHCP=n
CONFIG_IP_PNP_BOOTP=n
CONFIG_NET_IPIP=n
CONFIG_IP_MROUTE=n
CONFIG_IP_MROUTE_MULTIPLE_TABLES=n
CONFIG_IP_PIMSM_V1=n
CONFIG_IP_PIMSM_V2=n
CONFIG_SYN_COOKIES=n
CONFIG_INET_AH=n
CONFIG_INET_ESP=n
CONFIG_INET_IPCOMP=n
# CONFIG_INET_LRO is not set
CONFIG_IPV6_ROUTER_PREF=n
CONFIG_IPV6_ROUTE_INFO=n
CONFIG_IPV6_OPTIMISTIC_DAD=n
CONFIG_INET6_AH=n
CONFIG_INET6_ESP=n
CONFIG_INET6_IPCOMP=n
CONFIG_IPV6_MIP6=n
CONFIG_INET6_XFRM_MODE_ROUTEOPTIMIZATION=n
CONFIG_IPV6_SIT_6RD=n
CONFIG_IPV6_TUNNEL=n
CONFIG_IPV6_MULTIPLE_TABLES=n
CONFIG_IPV6_SUBTREES=n
CONFIG_IPV6_MROUTE=n
CONFIG_IPV6_PIMSM_V2=n
CONFIG_NETFILTER=n
CONFIG_NF_CONNTRACK=n
CONFIG_NF_CONNTRACK_EVENTS=n
CONFIG_NF_CT_PROTO_UDPLITE=n
CONFIG_NF_CONNTRACK_FTP=n
CONFIG_NF_CONNTRACK_PPTP=n
CONFIG_NF_CONNTRACK_SIP=n
CONFIG_NF_CONNTRACK_TFTP=n
CONFIG_NF_CT_NETLINK=n
CONFIG_NETFILTER_XT_CONNMARK=n
CONFIG_NETFILTER_XT_TARGET_CLASSIFY=n
CONFIG_NETFILTER_XT_TARGET_IDLETIMER=n
CONFIG_NETFILTER_XT_TARGET_MARK=n
CONFIG_NETFILTER_XT_TARGET_NFLOG=n
CONFIG_NETFILTER_XT_TARGET_NFQUEUE=n
CONFIG_NETFILTER_XT_TARGET_TCPMSS=n
CONFIG_NETFILTER_XT_MATCH_CONNBYTES=n
CONFIG_NETFILTER_XT_MATCH_IPRANGE=n
CONFIG_NETFILTER_XT_MATCH_LENGTH=n
CONFIG_NETFILTER_XT_MATCH_LIMIT=n
CONFIG_NETFILTER_XT_MATCH_MAC=n
CONFIG_NETFILTER_XT_MATCH_MARK=n
CONFIG_NETFILTER_XT_MATCH_MULTIPORT=n
CONFIG_NETFILTER_XT_MATCH_POLICY=n
CONFIG_NETFILTER_XT_MATCH_PHYSDEV=n
CONFIG_NETFILTER_XT_MATCH_QTAGUID=n
CONFIG_NETFILTER_XT_MATCH_QUOTA=n
CONFIG_NETFILTER_XT_MATCH_QUOTA2=n
CONFIG_NETFILTER_XT_MATCH_QUOTA2_LOG=n
CONFIG_NETFILTER_XT_MATCH_REALM=n
CONFIG_NETFILTER_XT_MATCH_RECENT=n
CONFIG_NETFILTER_XT_MATCH_SOCKET=n
CONFIG_NETFILTER_XT_MATCH_STATE=n
CONFIG_NETFILTER_XT_MATCH_STATISTIC=n
CONFIG_NETFILTER_XT_MATCH_STRING=n
CONFIG_NETFILTER_XT_MATCH_TCPMSS=n
CONFIG_NETFILTER_XT_MATCH_TIME=n
CONFIG_NETFILTER_XT_MATCH_U32=n
CONFIG_NF_CONNTRACK_IPV4=n
CONFIG_IP_NF_IPTABLES=n
CONFIG_IP_NF_FILTER=n
CONFIG_IP_NF_TARGET_REJECT=n
CONFIG_IP_NF_NAT=n
CONFIG_IP_NF_TARGET_MASQUERADE=n
CONFIG_IP_NF_TARGET_NETMAP=n
CONFIG_IP_NF_TARGET_REDIRECT=n
CONFIG_IP_NF_MANGLE=n
CONFIG_IP_NF_RAW=n
CONFIG_IP_NF_ARPTABLES=n
CONFIG_NF_CONNTRACK_IPV6=n
CONFIG_IP6_NF_IPTABLES=n
CONFIG_IP6_NF_MATCH_FRAG=n
CONFIG_IP6_NF_MATCH_IPV6HEADER=n
CONFIG_IP6_NF_TARGET_HL=n
CONFIG_IP6_NF_FILTER=n
CONFIG_IP6_NF_TARGET_REJECT=n
CONFIG_IP6_NF_MANGLE=n
CONFIG_IP6_NF_RAW=n
CONFIG_BRIDGE=n
CONFIG_VLAN_8021Q=m
CONFIG_NET_SCHED=n
CONFIG_NET_SCH_HTB=n
CONFIG_NET_SCH_INGRESS=n
CONFIG_NET_CLS_FW=n
CONFIG_NET_CLS_U32=n
CONFIG_CLS_U32_PERF=n
CONFIG_CLS_U32_MARK=n
CONFIG_NET_CLS_FLOW=n
CONFIG_NET_CLS_ACT=n
CONFIG_NET_ACT_POLICE=n
CONFIG_NET_ACT_MIRRED=n
CONFIG_NET_ACT_IPT=n
CONFIG_NET_CLS_IND=n
CONFIG_CFG80211=y
CONFIG_NL80211_TESTMODE=y
CONFIG_CFG80211_DEVELOPER_WARNINGS=y
# CONFIG_CFG80211_DEFAULT_PS is not set
CONFIG_CFG80211_INTERNAL_REGDB=y
CONFIG_MTD=y
# CONFIG_MTD_OF_PARTS is not set
CONFIG_MTD_BLOCK=y
CONFIG_MTD_NAND_IDS=y
CONFIG_ZRAM=y
CONFIG_ZRAM_LZ4K_COMPRESS=y
# CONFIG_ZRAM_DEBUG is not set
CONFIG_ZSM=y
CONFIG_BLK_DEV_LOOP=y
CONFIG_UID_STAT=y
CONFIG_UID_CPUTIME=y
CONFIG_MEDIATEK_SOLUTION=y
CONFIG_MTK_PLATFORM="mt6580"
CONFIG_ARCH_MTK_PROJECT="v2800"
CONFIG_MTK_SHARED_SDCARD=y
CONFIG_MTK_GPT_SCHEME_SUPPORT=y
CONFIG_MTK_SENSOR_SUPPORT=n
CONFIG_CUSTOM_KERNEL_IMGSENSOR="gc0310_mipi_yuv ov5670_mipi_raw_sunwin ov5670_mipi_raw_cmk gc2355_mipi_raw sp2508_mipi_raw"
CONFIG_MTK_IRQ=y
CONFIG_MTK_VIDEOCODEC_DRIVER=n
CONFIG_MTK_LEDS=y
CONFIG_MTK_LEDS_GPIO=y
CONFIG_MTK_VIBRATOR=y
CONFIG_MTK_SYSENV=y
CONFIG_MTPROF=y
CONFIG_MTK_CMDQ=y
CONFIG_MTK_SMI_EXT=y
CONFIG_MTK_CLKMGR=y
CONFIG_MTK_CHIP=y
CONFIG_MTK_CCCI_EXT=n
CONFIG_MTK_CCCI_DRIVER=n
CONFIG_MTK_DEVAPC_DRIVER=y
#CONFIG_MTK_GPU_SUPPORT=y
#CONFIG_MTK_GPU_VERSION="mali utgard"
CONFIG_MTK_MMPROFILE_SUPPORT=y
CONFIG_MMPROFILE=y
CONFIG_MTK_LCM=y
CONFIG_CUSTOM_KERNEL_LCM="ili9806e_fwvga_dsi_vdo_zgd fl10802_fwvga_dsi_vdo_txd jd9161_fwvga_dsi_vdo_dj"
CONFIG_MTK_FB=y
CONFIG_MTK_VIDEOX=y
CONFIG_MTK_LCM_PHYSICAL_ROTATION="0"
CONFIG_LCM_HEIGHT="854"
CONFIG_LCM_WIDTH="480"
CONFIG_MTK_SYNC=y
CONFIG_MTK_MET=y
CONFIG_MTK_MET_PLF=y
CONFIG_MTK_PWM=y
# CONFIG_MTK_TINNO_HALL move to baseline/vendor/tinno/v2800/trunk/cust_kcfg/Makefile
CONFIG_CUSTOM_KERNEL_ACCELEROMETER=n
# CONFIG_MTK_MC3410_NEW=y
CONFIG_MTK_KXTJ2_1009_NEW=y
CONFIG_MTK_BMA222E_NEW=y
CONFIG_CUSTOM_KERNEL_ALSPS=y
# CONFIG_MTK_CM36652_NEW=y
CONFIG_MTK_LTR553=y
#CONFIG_CUSTOM_KERNEL_GYROSCOPE=y
#CONFIG_MTK_ITG1010_NEW=y
#CONFIG_CUSTOM_KERNEL_MAGNETOMETER=y
#CONFIG_MTK_AKM09911_NEW=y
CONFIG_MTK_HWMON=y
CONFIG_MTK_FREQ_HOPPING=y
CONFIG_MTK_ACCDET=y
CONFIG_ACCDET_EINT=y
CONFIG_MTK_SEC_MODEM_NVRAM_ANTI_CLONE=y
CONFIG_MTK_RAM_CONSOLE=y
CONFIG_MTK_RAM_CONSOLE_USING_DRAM=y
CONFIG_MTK_RAM_CONSOLE_SIZE=0x3000
CONFIG_MTK_RAM_CONSOLE_ADDR=0xF912D000
CONFIG_MTK_RAM_CONSOLE_DRAM_SIZE=0x10000
CONFIG_MTK_RAM_CONSOLE_DRAM_ADDR=0x83F00000
CONFIG_GATOR_DRIVER=y
CONFIG_MTK_SCHED_RQAVG_KS=y
CONFIG_MTK_SCHED_RQAVG_US=y
CONFIG_MT_CPU_AFFINITY=y
CONFIG_MT_LOAD_BALANCE_ENHANCEMENT=y
CONFIG_MT_SCHED_INTEROP=y
#CONFIG_MTK_FMRADIO=y
#CONFIG_MTK_FM=y
#CONFIG_MTK_FM_SUPPORT=y
#CONFIG_MTK_FM_CHIP="MT6580_FM"
CONFIG_MTK_IMGSENSOR=y
CONFIG_MTK_BTIF=n
CONFIG_MTK_COMBO=n
CONFIG_MTK_COMBO_CHIP_CONSYS_6580=n
#CONFIG_MTK_COMBO_BT=y
#CONFIG_MTK_COMBO_GPS=y
CONFIG_MTK_COMBO_WIFI=n
#CONFIG_MTK_GPS_SUPPORT=y
CONFIG_MTK_LENS=y
CONFIG_MTK_LENS_DUMMYLENS_SUPPORT=y
# CONFIG_MTK_LENS_AD5820AF_SUPPORT=y
#CONFIG_MTK_LENS_DW9714AF_SUPPORT=y
# CONFIG_MTK_LENS_LC898212AF_SUPPORT=y
CONFIG_USB_MTK_HDRC=y
#CONFIG_USB_MTK_OTG=y
#CONFIG_USB_MTK_HDRC_HCD=y
CONFIG_MTK_FLASHLIGHT=y
CONFIG_CUSTOM_KERNEL_FLASHLIGHT="constant_flashlight"
CONFIG_MTK_AEE_FEATURE=y
CONFIG_MTK_THERMAL_PA_VIA_ATCMD=y
CONFIG_MTK_RTC=y
# CONFIG_MTK_EMI_MBW is not set
CONFIG_MTK_BTCVSD=y
CONFIG_SCSI=y
CONFIG_BLK_DEV_SD=y
CONFIG_SCSI_SCAN_ASYNC=y
# CONFIG_SCSI_LOWLEVEL is not set
CONFIG_MD=y
CONFIG_BLK_DEV_DM=y
CONFIG_DM_CRYPT=y
CONFIG_DM_UEVENT=y
CONFIG_DM_VERITY=y
CONFIG_NETDEVICES=n
CONFIG_IFB=n
CONFIG_TUN=n
# CONFIG_ETHERNET is not set
CONFIG_PPP=n
CONFIG_PPP_BSDCOMP=n
CONFIG_PPP_DEFLATE=n
CONFIG_PPP_FILTER=n
CONFIG_PPP_MPPE=n
CONFIG_PPP_MULTILINK=n
CONFIG_PPPOE=n
CONFIG_PPPOLAC=n
CONFIG_PPPOPNS=n
CONFIG_PPP_ASYNC=n
CONFIG_PPP_SYNC_TTY=n
# CONFIG_INPUT_MOUSEDEV is not set
CONFIG_INPUT_EVDEV=y
# CONFIG_KEYBOARD_ATKBD is not set
# CONFIG_INPUT_MOUSE is not set
CONFIG_INPUT_TOUCHSCREEN=y
CONFIG_TOUCHSCREEN_MTK=y
CONFIG_TOUCHSCREEN_MTK_FT6336=y
CONFIG_TOUCHSCREEN_MTK_EKTF2K_V3702=y
# CONFIG_TOUCHSCREEN_MTK_EKTF2K is not set
#CONFIG_TOUCHSCREEN_MTK_GT1151=y
CONFIG_GT1151_FIRMWARE="firmware1"
CONFIG_GT1151_CONFIG="config4"
CONFIG_GTP_DRIVER_SEND_CFG=y
CONFIG_GTP_CUSTOM_CFG=y
CONFIG_GTP_HOTKNOT=y
CONFIG_GTP_AUTO_UPDATE=y
CONFIG_GTP_HEADER_FW_UPDATE=y
CONFIG_GTP_CREATE_WR_NODE=y
CONFIG_GTP_POWER_CTRL_SLEEP=y
CONFIG_KEYBOARD_MTK=y
CONFIG_ONEKEY_REBOOT_NORMAL_MODE=y
CONFIG_ONEKEY_REBOOT_OTHER_MODE=y
CONFIG_KPD_PWRKEY_USE_PMIC=y
CONFIG_INPUT_MISC=y
CONFIG_INPUT_UINPUT=y
# CONFIG_SERIO is not set
# CONFIG_VT is not set
CONFIG_LEGACY_PTY_COUNT=16
# CONFIG_DEVMEM is not set
# CONFIG_DEVKMEM is not set
# CONFIG_HW_RANDOM is not set
CONFIG_I2C=y
CONFIG_SPI=y
CONFIG_MTK_SPI=y
CONFIG_POWER_SUPPLY=y
CONFIG_POWER_RESET=y
CONFIG_MTK_SMART_BATTERY=y
CONFIG_MTK_KERNEL_POWER_OFF_CHARGING=y
CONFIG_MTK_JEITA_STANDARD_SUPPORT=y
CONFIG_TINNO_QUICK_CHARGING=y
# CONFIG_HWMON is not set
CONFIG_THERMAL=y
CONFIG_THERMAL_DEFAULT_GOV_BACKWARD_COMPATIBLE=y
CONFIG_WATCHDOG=y
CONFIG_REGULATOR=y
CONFIG_FB=y
CONFIG_FB_MODE_HELPERS=y
CONFIG_FB_TILEBLITTING=y
CONFIG_SOUND=n
CONFIG_SND=n
CONFIG_SND_SEQUENCER=n
CONFIG_SND_MIXER_OSS=n
CONFIG_SND_PCM_OSS=n
CONFIG_SND_SEQUENCER_OSS=n
CONFIG_SND_HRTIMER=n
CONFIG_SND_DYNAMIC_MINORS=n
CONFIG_SND_VERBOSE_PRINTK=n
# CONFIG_SND_DEBUG is not set
# CONFIG_SND_DEBUG_VERBOSE is not set
# CONFIG_SND_PCM_XRUN_DEBUG is not set
# CONFIG_SND_ARM is not set
# CONFIG_SND_SPI is not set
CONFIG_SND_USB_AUDIO=n
CONFIG_SND_SOC=n
CONFIG_MT_SND_SOC_6580=n
# CONFIG_MTK_SPEAKER=y
CONFIG_SND_SIMPLE_CARD=n
CONFIG_SOUND_PRIME=n
CONFIG_HIDRAW=y
CONFIG_UHID=y
CONFIG_HID_A4TECH=n
CONFIG_HID_APPLE=y
CONFIG_HID_BELKIN=n
CONFIG_HID_CHERRY=n
CONFIG_HID_CHICONY=n
CONFIG_HID_CYPRESS=n
CONFIG_HID_DRAGONRISE=n
CONFIG_HID_EZKEY=n
CONFIG_HID_KYE=n
CONFIG_HID_GYRATION=n
CONFIG_HID_TWINHAN=n
CONFIG_HID_KENSINGTON=n
CONFIG_HID_LOGITECH=n
CONFIG_HID_MAGICMOUSE=n
CONFIG_HID_MICROSOFT=n
CONFIG_HID_MONTEREY=n
CONFIG_HID_PANTHERLORD=n
CONFIG_HID_PETALYNX=n
CONFIG_HID_SAMSUNG=n
CONFIG_HID_SUNPLUS=n
CONFIG_HID_GREENASIA=n
CONFIG_HID_SMARTJOYPLUS=n
CONFIG_HID_TOPSEED=n
CONFIG_HID_THRUSTMASTER=n
CONFIG_HID_ZEROPLUS=n
CONFIG_USB=y
CONFIG_USB_STORAGE=y
CONFIG_USB_STORAGE_DATAFAB=n
CONFIG_USB_STORAGE_FREECOM=n
CONFIG_USB_STORAGE_ISD200=n
CONFIG_USB_STORAGE_USBAT=n
CONFIG_USB_STORAGE_SDDR09=n
CONFIG_USB_STORAGE_SDDR55=n
CONFIG_USB_STORAGE_JUMPSHOT=n
CONFIG_USB_STORAGE_ALAUDA=n
CONFIG_USB_STORAGE_ONETOUCH=n
CONFIG_USB_STORAGE_KARMA=n
CONFIG_USB_STORAGE_CYPRESS_ATACB=n
CONFIG_USB_TRANCEVIBRATOR=y
CONFIG_NOP_USB_XCEIV=y
CONFIG_USB_GADGET=y
CONFIG_USB_GADGET_VBUS_DRAW=500
CONFIG_USB_G_ANDROID=y
CONFIG_MMC=y
CONFIG_MMC_BLOCK_MINORS=32
CONFIG_MMC_MTK=y
CONFIG_MTK_EMMC_SUPPORT=y
CONFIG_MTK_EMMC_CACHE=y
CONFIG_NEW_LEDS=y
CONFIG_LEDS_CLASS=y
CONFIG_LEDS_TRIGGERS=y
CONFIG_LEDS_TRIGGER_TIMER=y
CONFIG_SWITCH=y
CONFIG_RTC_CLASS=y
# CONFIG_RTC_SYSTOHC is not set
CONFIG_STAGING=y
CONFIG_ANDROID=y
CONFIG_ANDROID_BINDER_IPC=y
CONFIG_ASHMEM=y
CONFIG_ANDROID_LOW_MEMORY_KILLER=y
CONFIG_SYNC=y
CONFIG_SW_SYNC=y
CONFIG_SW_SYNC_USER=y
CONFIG_ION=y
CONFIG_MTK_ION=y
CONFIG_EXT4_FS=y
CONFIG_EXT4_FS_SECURITY=y
CONFIG_EXT4_FS_ENCRYPTION=y
CONFIG_FUSE_FS=y
CONFIG_ISO9660_FS=n
CONFIG_JOLIET=n
CONFIG_ZISOFS=n
CONFIG_MSDOS_FS=y
CONFIG_VFAT_FS=y
CONFIG_TMPFS=y
CONFIG_PSTORE=y
CONFIG_PSTORE_CONSOLE=y
CONFIG_PSTORE_PMSG=y
CONFIG_PSTORE_RAM=y
CONFIG_PSTORE_CONSOLE_SIZE=0x10000
CONFIG_PSTORE_PMSG_SIZE=0x10000
CONFIG_PSTORE_MEM_ADDR=0x83F10000
CONFIG_PSTORE_MEM_SIZE=0xe0000
CONFIG_NLS_CODEPAGE_437=y
CONFIG_NLS_CODEPAGE_950=y
CONFIG_NLS_ASCII=y
CONFIG_NLS_ISO8859_1=y
CONFIG_NLS_UTF8=y
CONFIG_PRINTK_TIME=y
# CONFIG_DYNAMIC_DEBUG is not set
# CONFIG_DEBUG_INFO is not set
CONFIG_FRAME_WARN=1400
CONFIG_MAGIC_SYSRQ=y
CONFIG_PANIC_ON_OOPS=y
CONFIG_PANIC_TIMEOUT=1
CONFIG_SCHEDSTATS=y
# CONFIG_DEBUG_BUGVERBOSE is not set
CONFIG_RCU_CPU_STALL_TIMEOUT=60
CONFIG_FAULT_INJECTION=y
CONFIG_ENABLE_DEFAULT_TRACERS=y
CONFIG_MTK_SCHED_TRACERS=y
# CONFIG_ARM_UNWIND is not set
CONFIG_SECURITY=y
CONFIG_SECURITY_NETWORK=y
CONFIG_SECURITY_SELINUX=y
CONFIG_SECURITY_SELINUX_BOOTPARAM=y
CONFIG_CRYPTO_NULL=y
CONFIG_CRYPTO_XCBC=y
CONFIG_CRYPTO_TWOFISH=y
CONFIG_CRYPTO_LZO=y
# CONFIG_CRYPTO_ANSI_CPRNG is not set
# CONFIG_CRYPTO_HW is not set
CONFIG_LIBCRC32C=y
CONFIG_PROJECT_V2800=y
CONFIG_RD_GZIP=y
CONFIG_RD_BZIP2=y
CONFIG_RD_LZMA=y
CONFIG_LZO_COMPRESS=y
CONFIG_LZO_DECOMPRESS=y
CONFIG_LZ4_COMPRESS=y
CONFIG_LZ4_DECOMPRESS=y
CONFIG_DECOMPRESS_GZIP=y
CONFIG_DECOMPRESS_BZIP2=y
CONFIG_DECOMPRESS_LZMA=y
```
